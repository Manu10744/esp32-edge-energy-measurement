## esp32-measurement-node/main/Kconfig.projbuild
```kconfig
menu "UDP Server Configuration"
    
    config USE_IPV4_STACK
        bool "IPV4"
        default y
        help 
            Should IPv4 be used for the UDP server?

    config USE_IPV6_STACK
        bool "IPV6"
        default n
        help 
            Should IPv6 be used for the UDP server?
        
    config PORT
        int "Port"
        range 0 65535
        default 3333
        help
            Port of the UDP server.

    config MAX_CLIENTS
        int "Maximum amount of clients"
        range 0 16
        default 6
        help
            Maximum amount of clients that are served.
            
endmenu
```

## esp32-powermeter-udp-server/components/power_measurement/Kconfig.projbuild
```kconfig
menu "Power Measurement Settings"
    
    config AMOUNT_OF_INA3221_SENSORS
        int "Amount of used INA3221 sensors"
        default 2
        help 
            How many INA3221 sensors are used?
    
    config MEASUREMENT_INTERVAL
        int "INA3221 channel measurement interval in ms (milli-seconds)"
        default 10
        help
            Sets the time interval that is used for the power measurement of each INA3221 channel. Lower values achieve a higher precision, but cause more computational effort.

endmenu
```

## esp32-powermeter-udp-server/components/wifi/Kconfig.projbuild
```kconfig
menu "WiFi Connection Settings"
    
    choice WIFI_SETTINGS

        bool "Choose from predefined profiles"
        default USE_HOME_WIFI_SETTINGS
        
        config USE_HOME_WIFI_SETTINGS
            bool "Use WiFi settings from home"
        config USE_INSTITUTE_WIFI_SETTINGS
            bool "Use WiFi settings from TUM institute"

    endchoice

    config WIFI_MAX_RECONNECTS
        int "Maximum amount of WiFi Reconnection attempts"
        default 5
        help
            How many WiFi Reconnect attempts should be executed if the initial connection to the WiFi AP does not succeed at the first attempt or the existing connection gets closed all of a sudden?

    config WIFI_RECONNECT_WAIT_INTERVAL_SECONDS
        int "WiFi Reconnect attempt timeout in s (seconds)"
        default 3
        help
            How many seconds to wait after each failed WiFi Reconnect attempt?
endmenu
```

## esp32-powermeter-udp-server/main/Kconfig.projbuild
```kconfig
menu "UDP Server Configuration"
    
    config USE_IPV4_STACK
        bool "IPV4"
        default y
        help 
            Should IPv4 be used for the UDP server?

    config USE_IPV6_STACK
        bool "IPV6"
        default n
        help 
            Should IPv6 be used for the UDP server?
        
    config PORT
        int "Port"
        range 0 65535
        default 30000
        help
            Which Port should be used for the UDP server?

    config MAX_CLIENTS
        int "Maximum amount of clients"
        range 0 16
        default 6
        help
            How many clients should be accepted by the UDP server?

    config SEND_INTERVAL
        int "Power measurement message transmission interval in ms (milli-seconds)"
        default 1000
        help
            Sets the time interval that is used for sending power measurements to a client.
            
endmenu

menu "SSD1306 Display Configuration"

    config USE_SSD1306_DISPLAY
        bool "Use a SSD1306 display"
        default y
        help
            Should the power measurements be visualized by the SSD1306 display? Disable this if no display is available.
    
    config DISPLAY_REFRESH_INTERVAL
        int "Refresh interval for the display in ms (milli-seconds)"
        default 500
        help
            Sets the time interval that is used for refreshing the SSD1306 display.
endmenu
```

## esp32_measurement_node/components/power_measurement/Kconfig.projbuild
```kconfig
menu "Power Measurement Settings"
    
    config AMOUNT_OF_CHANNELS
        int "Amount of available channels"
        default 3
        help 
            How many INA3221 channels are available?

endmenu
```

## esp32_measurement_node/components/wifi/Kconfig.projbuild
```kconfig
menu "WiFi Connection Settings"
    
    choice WIFI_SETTINGS

        bool "Choose from predefined profiles"
        default USE_HOME_WIFI_SETTINGS
        
        config USE_HOME_WIFI_SETTINGS
            bool "Use WiFi settings from home"
        config USE_INSTITUTE_WIFI_SETTINGS
            bool "Use WiFi settings from TUM institute"

    endchoice

    config WIFI_MAX_RETRIES
        int "Maximum amount of connection retries"
        range 0 10
        default 3
        help
            How many connection retries should be executed?
endmenu
```

## udp-client/main/Kconfig.projbuild
```kconfig
menu "UDP Client Configuration"
    
    config PORT
        int "Port"
        range 0 65535
        default 3333
        help
            Port of the UDP server to connect to.

endmenu
```

## udp-server/main/Kconfig.projbuild
```kconfig
menu "UDP Server Configuration"
    
    config USE_IPV4_STACK
        bool "IPV4"
        default y
        help 
            Soll IPv4 für den Server benutzt werden?

    config USE_IPV6_STACK
        bool "IPV6"
        default n
        help 
            Soll IPv6 für den Server genutzt werden?
        
    config PORT
        int "Port"
        range 0 65535
        default 3333
        help
            Local port the UDP server will listen on.
endmenu
```
